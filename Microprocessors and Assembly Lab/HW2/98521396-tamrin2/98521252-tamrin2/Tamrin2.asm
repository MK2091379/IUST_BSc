//AmirhosseinSamavat 98521252	

.include "m32def.inc"
		LDI		R16,HIGH(RAMEND)
		OUT		SPH,R16
		LDI		R16,LOW(RAMEND)
		OUT		SPL,R16

		LDI		R16,0xFF
		OUT		DDRC,R16		
		OUT		DDRD,R16		

		OUT		PORTA,R16		 
		LDI		R16,0x00
		OUT		DDRA,R16		

SET_ZERO:
		LDI		R16,0			
		LDI		R17,0			
		LDI		R18,0			
		LDI		R19,0			
		RJMP	DISPLAY

SET_9999:
		LDI		R16,9			
		LDI		R17,9			
		LDI		R18,9			
		LDI		R19,9			
		RJMP	DISPLAY

BEGIN:
		IN		R20,PINA
		ANDI	R20,0b00000001
		CPI		R20,0
		BRNE	DECREMENT

INCREMENT:
		CPI		R16,9
		BRLO	INC_UNITS
		CPI		R17,9
		BRLO	INC_TENTH
		CPI		R18,9
		BRLO	INC_HUNDREDTH
		CPI		R19,9
		BRLO	INC_THOUSANDTH
		RJMP	SET_ZERO

INC_UNITS:
		INC		R16
		RJMP	DISPLAY

INC_TENTH:
		INC		R17
		LDI		R16,0
		RJMP	DISPLAY

INC_HUNDREDTH:
		INC		R18
		LDI		R16,0
		LDI		R17,0
		RJMP	DISPLAY

INC_THOUSANDTH:
		INC		R19
		LDI		R16,0
		LDI		R17,0
		LDI		R18,0
		RJMP	DISPLAY

DECREMENT:
		CPI		R16,1
		BRSH	DEC_UNITS
		CPI		R17,1
		BRSH	DEC_TENTH
		CPI		R18,1
		BRSH	DEC_HUNDREDTH
		CPI		R19,1
		BRSH	DEC_THOUSANDTH
		RJMP	SET_9999

DEC_UNITS:
		DEC		R16
		RJMP	DISPLAY

DEC_TENTH:
		DEC		R17
		LDI		R16,9
		RJMP	DISPLAY

DEC_HUNDREDTH:
		DEC		R18
		LDI		R16,9
		LDI		R17,9
		RJMP	DISPLAY

DEC_THOUSANDTH:
		DEC		R19
		LDI		R16,9
		LDI		R17,9
		LDI		R18,9
		RJMP	DISPLAY

DISPLAY:
		LDI		R25,0b11111110	
		OUT		PORTD,R25
		MOV		R24,R19
		CALL	CONVERT
		OUT		PORTC,R24
		CALL	DELAY_DISP

		LDI		R25,0b11111101	
		OUT		PORTD,R25
		MOV		R24,R18
		CALL	CONVERT
		OUT		PORTC,R24
		CALL	DELAY_DISP

		LDI		R25,0b11111011	
		OUT		PORTD,R25
		MOV		R24,R17
		CALL	CONVERT
		OUT		PORTC,R24
		CALL	DELAY_DISP

		LDI		R25,0b11110111	
		OUT		PORTD,R25
		MOV		R24,R16
		CALL	CONVERT
		OUT		PORTC,R24
		CALL	DELAY_DISP
		RJMP	BEGIN

DELAY_DISP:
		LDI		R21,0x03
L1:		LDI		R22,0x35
L2:		LDI		R23,0xFF
L3:		DEC		R23
		BRNE	L3
		DEC		R22
		BRNE	L2
		DEC		R21
		BRNE	L1
		RET

CONVERT:
		CPI		R24,0
		BRNE	C1
		LDI		R24,0x3F
		RET

C1:		CPI		R24,1
		BRNE	C2
		LDI		R24,0x06
		RET

C2:		CPI		R24,2
		BRNE	C3
		LDI		R24,0x5B
		RET

C3:		CPI		R24,3
		BRNE	C4
		LDI		R24,0x4F
		RET
C4:		CPI		R24,4
		BRNE	C5
		LDI		R24,0x66
		RET

C5:		CPI		R24,5
		BRNE	C6
		LDI		R24,0x6D
		RET

C6:		CPI		R24,6
		BRNE	C7
		LDI		R24,0x7D
		RET

C7:		CPI		R24,7
		BRNE	C8
		LDI		R24,0x07
		RET

C8:		CPI		R24,8
		BRNE	C9
		LDI		R24,0x7F
		RET

C9:		CPI		R24,9
		BRNE	C10
		LDI		R24,0x6F
C10:	RET

